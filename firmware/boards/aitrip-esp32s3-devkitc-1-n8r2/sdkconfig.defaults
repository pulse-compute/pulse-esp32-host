## firmware/boards/aitrip-esp32s3-devkitc-1-n8r2/sdkconfig.defaults
```kconfig
# HP2 named-board host realization: AITRIP ESP32-S3-DevKitC-1 N8R2.
CONFIG_LOG_DEFAULT_LEVEL_INFO=y
CONFIG_COMPILER_OPTIMIZATION_SIZE=y
CONFIG_APP_REPRODUCIBLE_BUILD=y

CONFIG_PARTITION_TABLE_CUSTOM=y
CONFIG_PARTITION_TABLE_CUSTOM_FILENAME="partitions.csv"
CONFIG_ESPTOOLPY_FLASHSIZE_8MB=y

CONFIG_SPIRAM=y
CONFIG_SPIRAM_MODE_QUAD=y
CONFIG_SPIRAM_SPEED_40M=y
CONFIG_SPIRAM_USE_MALLOC=y
CONFIG_SPIRAM_MALLOC_ALWAYSINTERNAL=4096
CONFIG_SPIRAM_MALLOC_RESERVE_INTERNAL=32768

CONFIG_ELF_LOADER=y
# CONFIG_ELF_DYNAMIC_LOAD_SHARED_OBJECT is not set
CONFIG_ELF_LOADER_LOAD_PSRAM=y
# CONFIG_ELF_LOADER_LIBC_SYMBOLS is not set
# CONFIG_ELF_LOADER_ESPIDF_SYMBOLS is not set
# CONFIG_ELF_LOADER_CUSTOMER_SYMBOLS is not set

CONFIG_FREERTOS_SUPPORT_STATIC_ALLOCATION=y
CONFIG_FREERTOS_TLSP_DELETION_CALLBACKS=y
CONFIG_FREERTOS_THREAD_LOCAL_STORAGE_POINTERS=1
CONFIG_FREERTOS_CHECK_STACKOVERFLOW_CANARY=y
CONFIG_ESP_MAIN_TASK_STACK_SIZE=16384

CONFIG_ESP_CONSOLE_UART_DEFAULT=y
CONFIG_ESP_CONSOLE_SECONDARY_USB_SERIAL_JTAG=y
```

## firmware/boards/seeed-xiao-esp32c6-4m/sdkconfig.defaults
```kconfig
# HP2 named-board host realization: Seeed Studio XIAO ESP32C6, 4 MB, no PSRAM.
CONFIG_LOG_DEFAULT_LEVEL_INFO=y
CONFIG_COMPILER_OPTIMIZATION_SIZE=y
CONFIG_APP_REPRODUCIBLE_BUILD=y

CONFIG_PARTITION_TABLE_CUSTOM=y
CONFIG_PARTITION_TABLE_CUSTOM_FILENAME="partitions.csv"
CONFIG_ESPTOOLPY_FLASHSIZE_4MB=y

CONFIG_ELF_LOADER=y
# CONFIG_ESP_SYSTEM_PMP_IDRAM_SPLIT is not set
# CONFIG_ELF_DYNAMIC_LOAD_SHARED_OBJECT is not set
# CONFIG_ELF_LOADER_LOAD_PSRAM is not set
# CONFIG_ELF_LOADER_CACHE_OFFSET is not set
# CONFIG_ELF_LOADER_LIBC_SYMBOLS is not set
# CONFIG_ELF_LOADER_ESPIDF_SYMBOLS is not set
# CONFIG_ELF_LOADER_CUSTOMER_SYMBOLS is not set

CONFIG_FREERTOS_SUPPORT_STATIC_ALLOCATION=y
CONFIG_FREERTOS_TLSP_DELETION_CALLBACKS=y
CONFIG_FREERTOS_THREAD_LOCAL_STORAGE_POINTERS=1
CONFIG_FREERTOS_CHECK_STACKOVERFLOW_CANARY=y
CONFIG_ESP_MAIN_TASK_STACK_SIZE=16384

CONFIG_ESP_CONSOLE_USB_SERIAL_JTAG=y
```
